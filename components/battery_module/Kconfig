## components/battery_module/Kconfig
```kconfig
menu "TEF Battery Module Configuration"

    config TEF_BATTERY_ENABLE
        bool "Enable Battery Subsystem"
        default y
        help
            Enables periodic battery monitoring, voltage sampling via ADC / fuel gauge,
            and BAS / split telemetry reporting.

    config TEF_BATTERY_ADC_GPIO
        int "Battery ADC GPIO Pin"
        default 7
        range -1 48
        depends on TEF_BATTERY_ENABLE
        help
            GPIO pin for the battery voltage divider. On ESP32-S3, GPIO 7 corresponds to
            ADC1_CH6 (allocated for split half battery sensing per pin budget).
            Set to -1 to disable analog ADC reading.

    config TEF_BATTERY_DIVIDER_RATIO_PERMILLE
        int "Voltage Divider Ratio in Permille (e.g. 2000 for 2.0x)"
        default 2000
        range 1000 10000
        depends on TEF_BATTERY_ENABLE
        help
            Permille multiplier for the voltage divider.
            2000 corresponds to a 2.0x divider (such as 1 M / 1 M or 100 k / 100 k).

    config TEF_BATTERY_MIN_MV
        int "Minimum Battery Cutoff Voltage (mV)"
        default 3300
        range 2500 3700
        depends on TEF_BATTERY_ENABLE
        help
            Battery voltage in millivolts corresponding to 0% charge level.

    config TEF_BATTERY_MAX_MV
        int "Maximum Battery Full Voltage (mV)"
        default 4200
        range 3800 4500
        depends on TEF_BATTERY_ENABLE
        help
            Battery voltage in millivolts corresponding to 100% charge level.

    config TEF_BATTERY_POLL_INTERVAL_SEC
        int "Battery Notification Interval (seconds)"
        default 60
        range 5 3600
        depends on TEF_BATTERY_ENABLE
        help
            Maximum time between periodic battery percentage telemetry reports.

    config TEF_BATTERY_DELTA_NOTIFY_PCT
        int "Battery Delta Percentage for Notification"
        default 2
        range 1 50
        depends on TEF_BATTERY_ENABLE
        help
            Change in battery percentage that immediately triggers a BLE / event_bus notification.

    config TEF_BATTERY_I2C_FUEL_GAUGE
        bool "Enable I2C Fuel Gauge (MAX17048)"
        default n
        depends on TEF_BATTERY_ENABLE
        help
            Enables I2C Fuel Gauge querying on GPIO 43 (SDA) / 44 (SCL).

endmenu
```

## components/keyboard/Kconfig
```kconfig
menu "TEF Keyboard Configuration"

    config TEF_DEBUG_LATENCY_PIN
        int "Latency Debug Output GPIO Pin (-1 to disable)"
        default -1
        range -1 48
        help
            GPIO pin toggled when a new keypress enters the NKRO report.
            Connect to a logic analyzer together with the key switch
            to measure internal matrix scanning and debouncing latency.
            Set to -1 to disable.

    config TEF_MATRIX_SETTLE_US
        int "Matrix column settle time (microseconds)"
        default 20
        range 1 100
        help
            Delay in microseconds after asserting a column pin before reading row pins.
            Default is 20 us (~13 us estimated RC time constant).

    config TEF_EAGER_DEBOUNCE
        bool "Enable eager debouncing (immediate keypress on first scan)"
        default y
        help
            When enabled, a detected keypress is confirmed immediately on the first
            scan (or after TEF_PRESS_CONFIRM_SCANS), reducing input latency from ~4-5 ms
            to <1.2 ms. Release requires TEF_RELEASE_DEBOUNCE_SCANS consecutive low scans.

    config TEF_PRESS_CONFIRM_SCANS
        int "Scans required to confirm keypress"
        default 1
        range 1 10
        depends on TEF_EAGER_DEBOUNCE
        help
            Number of consecutive active scans required before confirming a press.
            Default is 1 (immediate lowest latency). Set to 2 to filter aggressive EMI glitches.

    config TEF_RELEASE_DEBOUNCE_SCANS
        int "Scans required to confirm key release"
        default 5
        range 1 20
        help
            Number of consecutive inactive scans required before releasing a key.
            Default is 5 scans (5 ms at 1000 Hz).

endmenu
```

## components/power_mgr/Kconfig
```kconfig
menu "TEF Unified Power Manager Configuration"

    config TEF_POWER_MGR
        bool "Enable Unified Power Manager"
        default y
        help
            Enables dynamic frequency scaling (DFS), CPU max-frequency locks,
            and managed light/deep sleep state transitions.
            If disabled, the CPU runs at static 240 MHz (legacy behavior).

    config TEF_PM_IDLE_TIMEOUT_MS
        int "Inactivity timeout to enter IDLE state (ms)"
        default 5000
        range 500 60000
        depends on TEF_POWER_MGR
        help
            Inactivity time (no key press or traffic) before releasing the 240 MHz
            CPU frequency lock and dropping to DFS base frequency (80 MHz).

    config TEF_PM_ENABLE_LIGHT_SLEEP
        bool "Enable Light Sleep in wireless mode"
        default y
        depends on TEF_POWER_MGR
        help
            Allows the system to enter light sleep when inactive in wireless mode.

    config TEF_PM_LIGHT_SLEEP_TIMEOUT_MS
        int "Inactivity timeout to enter Light Sleep (ms)"
        default 30000
        range 5000 600000
        depends on TEF_PM_ENABLE_LIGHT_SLEEP
        help
            Inactivity time in milliseconds before transitioning to Light Sleep
            when USB is disconnected and matrix is idle.

    config TEF_PM_ENABLE_DEEP_SLEEP
        bool "Enable Deep Sleep on long inactivity"
        default y
        depends on TEF_POWER_MGR
        help
            Allows the system to enter deep sleep after extended inactivity.

    config TEF_PM_DEEP_SLEEP_TIMEOUT_MS
        int "Inactivity timeout to enter Deep Sleep (ms)"
        default 900000
        range 60000 7200000
        depends on TEF_PM_ENABLE_DEEP_SLEEP
        help
            Inactivity time in milliseconds before entering deep sleep (default 15 minutes = 900,000 ms).

endmenu
```
